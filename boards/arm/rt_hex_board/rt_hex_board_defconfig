## boards/arm/rt_hex_board/rt_hex_board_defconfig
```kconfig
# File Path: boards/arm/rt_hex_board/rt_hex_board_defconfig
CONFIG_SOC_SERIES_STM32F4X=y
CONFIG_SOC_STM32F405XG=y
CONFIG_BOARD_RT_HEX_BOARD=y

# Hardware Core Performance Configurations (Stable -> Secure -> Fast)
CONFIG_SYS_CLOCK_HW_CYCLES_PER_SEC=10000000 # Synchronizes kernel to 10.0 MHz Industrial Divider
CONFIG_SERIAL=y
CONFIG_GPIO=y
CONFIG_ADC=y

# Hardened Network Communication Overrides
CONFIG_NET_L2_ETHERNET=y
CONFIG_NET_IPV4=y
CONFIG_NET_TCP=y
CONFIG_NET_SOCKETS=y
CONFIG_NET_SOCKETS_POSIX_NAMES=y
```
