// File Path: boards/arm/rt_hex_board/rt_hex_board.dts
/dts-v1/;
#include <st/f4/stm32f405Xg.dtsi>
#include <st/f4/stm32f405rgtx-pinctrl.dtsi>

/ {
    model = "Revolutionary Technology Company Custom 16-State Hex Board Engine";
    compatible = "rt,hex-board-v1", "st,stm32f405";

    chosen {
        zephyr,console = &usart1;
        zephyr,shell-uart = &usart1;
        zephyr,sram = &sram0;
        zephyr,flash = &flash0;
        // Bind the master network communications channel to the secure Docker fabric
        zephyr,network = &ethernet_bridge;
    };

    -------------------------------------------------------------------------
    -- HARDWARE PROPERTY DEFINTIONS: NATIVE 16-STATE LOGIC INTERFACES
    -------------------------------------------------------------------------
    rt_hex_silicon: rt-hex-silicon-interface {
        compatible = "rt,hex-silicon-v1";
        status = "okay";
        
        // Parallel input lines coming straight from Micrel SY10E445 outputs (Q0 - Q3)
        micrel-parallel-gpios = <&gpioa 0 GPIO_ACTIVE_HIGH>,  // Parallel Bit 0
                                <&gpioa 1 GPIO_ACTIVE_HIGH>,  // Parallel Bit 1
                                <&gpioa 2 GPIO_ACTIVE_HIGH>,  // Parallel Bit 2
                                <&gpioa 3 GPIO_ACTIVE_HIGH>;  // Parallel Bit 3

        // Control lines routing directly to the TI CD4514B 4-to-16 Line Decoder
        ti-decoder-latch-en-gpios = <&gpiob 5 GPIO_ACTIVE_HIGH>; // Latches current hex nibble
        ti-decoder-inhibit-gpios  = <&gpiob 6 GPIO_ACTIVE_LOW>;  // Master interlock clear line
    };
};

&uxart1 {
    pinctrl-0 = <&usart1_tx_pb6 &usart1_rx_pb7>;
    pinctrl-names = "default";
    current-speed = <115200>;
    status = "okay";
};

-------------------------------------------------------------------------
-- ANALOG CORE PROTECTION: 2mV TOLERANCE WINDOW SAMPLING RADAR
-------------------------------------------------------------------------
&adc1 {
    status = "okay";
    pinctrl-0 = <&adc1_in0_pa0>; // Hooked to your XC6602 0.5V isolated reference rail
    pinctrl-names = "default";
    
    #address-cells = <1>;
    #size-cells = <0>;

    channel@0 {
        reg = <0>;
        zephyr,gain = "ADC_GAIN_1";
        zephyr,reference = "ADC_REF_INTERNAL";
        zephyr,acquisition-time = <ADC_ACQ_TIME_DEFAULT>;
        zephyr,resolution = <12>; // 12-bit precision ensures microvolt tracking boundaries
    };
};

&ethernet_bridge {
    status = "okay";
    pinctrl-0 = <&eth_mii_tx_clk_pc3 &eth_mii_tx_en_pg11>;
    pinctrl-names = "default";
};
